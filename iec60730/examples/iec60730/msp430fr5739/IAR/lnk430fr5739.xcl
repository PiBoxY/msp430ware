// ************************************************
//
// XLINK configuration file for MSP430FR5739
//
// Copyright 1996-2012 IAR Systems AB
//
// $Revision: 9167 $
//
// ************************************************

// ---------------------------------------------------------
// Description
//

//
// Usage:
//
//   xlink [file file ...] -f lnk430fr5739.xcl
//
// -----------------------------------------------
// Device summary
//

//
// Core:                           MSP430
//
// Interrupt vectors:              56
//
// Peripheral units:                  0-0FFF
//
// Read/write memory (RAM):        1C00-1FFF
//
// Read-only memory (FRAM):        C200-FFFF
//


// -----------------------------------------------
// Segments
//

// -------------------------------------
// Data read/write segments (RAM)
//

//
// segment         Usage
// -------         --------------------------
// DATA16_Z        Data initialized to zero
// DATA16_I        Data initialized by copying from DATA16_ID
// DATA16_N        Data defined using __no_init
// DATA16_P        Data defined using __persistent
// DATA16_HEAP     The heap used by 'malloc' and 'free'
// CSTACK          Runtime stack
// TLS16_I         Thread-local storage for main thread
//                 (require custom runtime library)
//


// -------------------------------------
// Program and data read-only segments (FRAM)
//

//
// segment         Usage
// -------         --------------------------
// DATA16_C        Constant data, including string literals
// DATA16_ID       initializers for DATA<nn>_I
// INFO            Information memory
// INFOA           Information memory, bank A
// INFOB           Information memory, bank B
// CSTART          Program startup code
// CODE            Program code
// ISR_CODE        Program code for interrupt service routines
// DIFUNCT         Dynamic initialization vector used by C++
// CHECKSUM        Checksum byte(s) generated by the -J option
// INTVEC          Interrupt vectors
// RESET           The reset vector
// TLS16_ID        Thread-local initializers for main thread
//                 (require custom runtime library)
//
// Notes:
//
// * The INFOx and INFO segments overlap, this allows data either to be
//   placed in a specific bank or anywhere in the info memory.
//
// * The INTVEC and RESET segments overlap. This allows an application to
//   either use the reset vector provided by the runtime library, or
//   provide a reset function by defining an interrupt function associated
//   with the reset vector.
//


// ---------------------------------------------------------
// Configuation
//

// -----------------------------------------------
// Stack and heap sizes
//

// Uncomment for command line use
//-D_STACK_SIZE=80
//-D_DATA16_HEAP_SIZE=80


// -----------------------------------------------
// Define cpu
//

-cmsp430


// -----------------------------------------------
// Support for placing functions in read/write memory
//

-QCODE_I=CODE_ID


// ---------------------------------------------------------
// Placement directives
//

// -----------------------------------------------
// Read/write memory
//

-Z(DATA)DATA16_I,DATA16_Z,DATA16_N,TLS16_I,DATA16_HEAP+_DATA16_HEAP_SIZE=1C00-1FFF
-Z(DATA)CODE_I
-Z(DATA)CSTACK+_STACK_SIZE#


// -----------------------------------------------
// Read-only memory
//


// -------------------------------------
// Constant data
//

-Z(CONST)DATA16_C,DATA16_ID,DATA16_P,TLS16_ID,DIFUNCT


// -------------------------------------
// Code
//
-Z(CODE)PC_TEST_SECTION_1=D554-D55D
-Z(CODE)PC_TEST_SECTION_2=EAAA-EAB3
-Z(CODE)CSTART,ISR_CODE,CODE_ID=C200-FF8F
-Z(DATA)CHECKSUM=1880-1881
-P(CODE)CODE=C200-FF8F


// -------------------------------------
// Interrupt vectors
//

-Z(CODE)INTVEC=FF90-FFFF
-Z(CODE)RESET=FFFE-FFFF


// ---------------------------------------------------------
// CRC16 calculation -H for fill,-J for checksum calculation
// ---------------------------------------------------------

-HFF3F         

-J2,crc16,,,CHECKSUM,,#0xFFFF=C200-FF7F