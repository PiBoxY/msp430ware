# MPY_32__Multiplier__32_Bit_Mode_1 register map
Vendor: Texas Instruments
Peripheral module from a debugger description file (folder msp430).
Registers are 16-bit, access not given, no defined reset value unless marked. A register's access mark holds for its fields unless they carry their own. Offsets are as the file gives them; lines under a group give offsets from that group; [hi:lo] are bit positions; {n}, {i} and the like mark numbered series; 'fields as' and 'values as' point back to an identical list; <NAME> marks a mode.

## MPY_32_Multiplier_32_Bit_Mode
0x4D0 MPY32L — 32-bit operand 1 - multiply - low word
0x4D2 MPY32H — 32-bit operand 1 - multiply - high word
0x4D4 MPYS32L — 32-bit operand 1 - signed multiply - low word
0x4D6 MPYS32H — 32-bit operand 1 - signed multiply - high word
0x4D8 MAC32L — 32-bit operand 1 - multiply accumulate - low word
0x4DA MAC32H — 32-bit operand 1 - multiply accumulate - high word
0x4DC MACS32L — 32-bit operand 1 - signed multiply accumulate - low word
0x4DE MACS32H — 32-bit operand 1 - signed multiply accumulate - high word
0x4E0 OP2L — 32-bit operand 2 - low word
0x4E2 OP2H — 32-bit operand 2 - high word
0x4E4 RES0 — 32x32-bit result 0 - least significant word
0x4E6 RES1 — 32x32-bit result 1
0x4E8 RES2 — 32x32-bit result 2
0x4EA RES3 — 32x32-bit result 3 - most significant word
