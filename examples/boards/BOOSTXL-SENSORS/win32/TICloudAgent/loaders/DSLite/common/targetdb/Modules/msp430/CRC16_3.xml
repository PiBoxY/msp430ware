# CRC16_3 register map
Vendor: Texas Instruments
Peripheral module from a debugger description file (folder msp430).
Registers are 16-bit, access not given, no defined reset value unless marked. A register's access mark holds for its fields unless they carry their own. Offsets are as the file gives them; lines under a group give offsets from that group; [hi:lo] are bit positions; {n}, {i} and the like mark numbered series; 'fields as' and 'values as' point back to an identical list; <NAME> marks a mode.

## CRC16
0x1C0 CRCDI — CRC Data In Register
0x1C2 CRCDIRB — CRC data in reverse byte Register
0x1C4 CRCINIRES — CRC Initialisation Register and Result Register
0x1C6 CRCRESR — CRC reverse result Register
