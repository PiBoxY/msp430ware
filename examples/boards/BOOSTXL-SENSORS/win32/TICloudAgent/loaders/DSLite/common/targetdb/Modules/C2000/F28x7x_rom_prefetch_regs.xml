# F28x7x_rom_prefetch_regs register map
Vendor: Texas Instruments
Peripheral module from a debugger description file (folder C2000).
Address unit: 16 bits
Registers are 32-bit, read-write, no defined reset value unless marked. A register's access mark holds for its fields unless they carry their own. Offsets are as the file gives them; lines under a group give offsets from that group; [hi:lo] are bit positions; {n}, {i} and the like mark numbered series; 'fields as' and 'values as' point back to an identical list; <NAME> marks a mode.

## ROM_PREFETCH_REGS
0x00 ROMPREFETCH — ROM Prefetch Configuration Register
  [0] PFDISABLE — ROM Prefetch Enable/Disable Control
